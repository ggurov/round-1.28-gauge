## firmware/components/bsp/Kconfig
```kconfig
menu "Round gauge BSP"

menu "LCD (GC9A01A 240x240 SPI)"

config BSP_LCD_SPI_HOST
    int "SPI peripheral (2 = SPI2/FSPI, 3 = SPI3)"
    range 1 3
    default 2

config BSP_LCD_PIN_SCK
    int "SCLK GPIO"
    default 10

config BSP_LCD_PIN_MOSI
    int "MOSI GPIO"
    default 11

config BSP_LCD_PIN_CS
    int "CS GPIO"
    default 9

config BSP_LCD_PIN_DC
    int "DC GPIO"
    default 8

config BSP_LCD_PIN_RST
    int "RESET GPIO"
    default 12

config BSP_LCD_PIN_BL
    int "Backlight GPIO (-1 to disable)"
    default 40

config BSP_LCD_SPI_CLK_MHZ
    int "SPI clock (MHz)"
    range 10 80
    default 40
    help
        The Waveshare board and GC9A01A are rated to 80 MHz.  A 240x240
        RGB565 frame is 115 KB, so the clock sets the frame rate ceiling:
        40 MHz gives about 23 ms per full screen.

config BSP_LCD_SWAP_RGB565_BYTES
    bool "Byte-swap RGB565 before SPI transmit"
    default y
    help
        Framebuffers are little-endian RGB565; the panel latches the high byte
        first.  Turn this off only if colours come out wrong but shapes are
        right.

endmenu

config BSP_BACKLIGHT_DEFAULT_PERCENT
    int "Backlight level at boot (0-100)"
    range 0 100
    default 60

endmenu
```
